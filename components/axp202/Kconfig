## components/axp202/Kconfig
```kconfig
menu "Power system configuration (AXP202)"

menu "Output control"
    config AXP202_DCDC23_LDO234_EXTEN_CONTROL_BIT6_SELECTED
        bool "Enable LDO3"
        default y
    config AXP202_DCDC23_LDO234_EXTEN_CONTROL_BIT4_SELECTED
        bool "Enable DC-DC2"
        default y
    config AXP202_DCDC23_LDO234_EXTEN_CONTROL_BIT3_SELECTED
        bool "Enable LDO4"
        default y
    config AXP202_DCDC23_LDO234_EXTEN_CONTROL_BIT2_SELECTED
        bool "Enable LDO2"
        default y
    config AXP202_DCDC23_LDO234_EXTEN_CONTROL_BIT1_SELECTED
        bool "Enable DC-DC3"
        default y
    config AXP202_DCDC23_LDO234_EXTEN_CONTROL_BIT0_SELECTED
        bool "Enable EXTEN"
        default y
endmenu

config AXP202_DCDC23_LDO234_EXTEN_CONTROL_BIT6
    hex
    default 0x00 if !AXP202_DCDC23_LDO234_EXTEN_CONTROL_BIT6_SELECTED
    default 0x40 if AXP202_DCDC23_LDO234_EXTEN_CONTROL_BIT6_SELECTED

config AXP202_DCDC23_LDO234_EXTEN_CONTROL_BIT4
    hex
    default 0x00 if !AXP202_DCDC23_LDO234_EXTEN_CONTROL_BIT4_SELECTED
    default 0x10 if AXP202_DCDC23_LDO234_EXTEN_CONTROL_BIT4_SELECTED

config AXP202_DCDC23_LDO234_EXTEN_CONTROL_BIT3
    hex
    default 0x00 if !AXP202_DCDC23_LDO234_EXTEN_CONTROL_BIT3_SELECTED
    default 0x08 if AXP202_DCDC23_LDO234_EXTEN_CONTROL_BIT3_SELECTED

config AXP202_DCDC23_LDO234_EXTEN_CONTROL_BIT2
    hex
    default 0x00 if !AXP202_DCDC23_LDO234_EXTEN_CONTROL_BIT2_SELECTED
    default 0x04 if AXP202_DCDC23_LDO234_EXTEN_CONTROL_BIT2_SELECTED

config AXP202_DCDC23_LDO234_EXTEN_CONTROL_BIT1
    hex
    default 0x00 if !AXP202_DCDC23_LDO234_EXTEN_CONTROL_BIT1_SELECTED
    default 0x02 if AXP202_DCDC23_LDO234_EXTEN_CONTROL_BIT1_SELECTED

config AXP202_DCDC23_LDO234_EXTEN_CONTROL_BIT0
    hex
    default 0x00 if !AXP202_DCDC23_LDO234_EXTEN_CONTROL_BIT0_SELECTED
    default 0x01 if AXP202_DCDC23_LDO234_EXTEN_CONTROL_BIT0_SELECTED


menu "Output voltage"

    choice AXP202_DCDC2_VOLTAGE_BIT50
        prompt "DC-DC2 output voltage"
        default AXP202_DCDC2_VOLTAGE_BIT50_1V8

        config AXP202_DCDC2_VOLTAGE_BIT50_0V7
            bool "0.7V"
        config AXP202_DCDC2_VOLTAGE_BIT50_0V8
            bool "0.8V"
        config AXP202_DCDC2_VOLTAGE_BIT50_0V9
            bool "0.9V"
        config AXP202_DCDC2_VOLTAGE_BIT50_1V0
            bool "1.0V"
        config AXP202_DCDC2_VOLTAGE_BIT50_1V1
            bool "1.1V"
        config AXP202_DCDC2_VOLTAGE_BIT50_1V2
            bool "1.2V"
        config AXP202_DCDC2_VOLTAGE_BIT50_1V3
            bool "1.3V"
        config AXP202_DCDC2_VOLTAGE_BIT50_1V4
            bool "1.4V"
        config AXP202_DCDC2_VOLTAGE_BIT50_1V5
            bool "1.5V"
        config AXP202_DCDC2_VOLTAGE_BIT50_1V6
            bool "1.6V"
        config AXP202_DCDC2_VOLTAGE_BIT50_1V7
            bool "1.7V"
        config AXP202_DCDC2_VOLTAGE_BIT50_1V8
            bool "1.8V"
        config AXP202_DCDC2_VOLTAGE_BIT50_1V9
            bool "1.9V"
        config AXP202_DCDC2_VOLTAGE_BIT50_2V0
            bool "2.0V"
        config AXP202_DCDC2_VOLTAGE_BIT50_2V1
            bool "2.1V"
        config AXP202_DCDC2_VOLTAGE_BIT50_2V2
            bool "2.2V"
        config AXP202_DCDC2_VOLTAGE_BIT50_2V3
            bool "2.3V"
        config AXP202_DCDC2_VOLTAGE_BIT50_2V3
            bool "2.4V"
        config AXP202_DCDC2_VOLTAGE_BIT50_2V4
            bool "2.5V"
        config AXP202_DCDC2_VOLTAGE_BIT50_2V5
            bool "2.6V"
        config AXP202_DCDC2_VOLTAGE_BIT50_2V6
            bool "2.6V"
        config AXP202_DCDC2_VOLTAGE_BIT50_2V7
            bool "2.7V"
    endchoice

    config AXP202_DCDC2_VOLTAGE_BIT50
        hex
        default 0x00 if AXP202_DCDC2_VOLTAGE_BIT50_0V7
        default 0x04 if AXP202_DCDC2_VOLTAGE_BIT50_0V8
        default 0x08 if AXP202_DCDC2_VOLTAGE_BIT50_0V9
        default 0x0c if AXP202_DCDC2_VOLTAGE_BIT50_1V0
        default 0x10 if AXP202_DCDC2_VOLTAGE_BIT50_1V1
        default 0x14 if AXP202_DCDC2_VOLTAGE_BIT50_1V2
        default 0x18 if AXP202_DCDC2_VOLTAGE_BIT50_1V3
        default 0x1c if AXP202_DCDC2_VOLTAGE_BIT50_1V4
        default 0x20 if AXP202_DCDC2_VOLTAGE_BIT50_1V5
        default 0x24 if AXP202_DCDC2_VOLTAGE_BIT50_1V6
        default 0x28 if AXP202_DCDC2_VOLTAGE_BIT50_1V7
        default 0x2c if AXP202_DCDC2_VOLTAGE_BIT50_1V8
        default 0x30 if AXP202_DCDC2_VOLTAGE_BIT50_1V9
        default 0x34 if AXP202_DCDC2_VOLTAGE_BIT50_2V0
        default 0x38 if AXP202_DCDC2_VOLTAGE_BIT50_2V1
        default 0x3c if AXP202_DCDC2_VOLTAGE_BIT50_2V2
        default 0x40 if AXP202_DCDC2_VOLTAGE_BIT50_2V3
        default 0x44 if AXP202_DCDC2_VOLTAGE_BIT50_2V4
        default 0x48 if AXP202_DCDC2_VOLTAGE_BIT50_2V5
        default 0x4c if AXP202_DCDC2_VOLTAGE_BIT50_2V6
        default 0x50 if AXP202_DCDC2_VOLTAGE_BIT50_2V7

    choice AXP202_DCDC3_VOLTAGE_BIT60
        prompt "DC-DC3 output voltage"
        default AXP202_DCDC3_VOLTAGE_BIT60_3V0
        config AXP202_DCDC3_VOLTAGE_BIT60_0V7
            bool "0.7V"
        config AXP202_DCDC3_VOLTAGE_BIT60_0V8
            bool "0.8V"
        config AXP202_DCDC3_VOLTAGE_BIT60_0V9
            bool "0.9V"
        config AXP202_DCDC3_VOLTAGE_BIT60_1V0
            bool "1.0V"
        config AXP202_DCDC3_VOLTAGE_BIT60_1V1
            bool "1.1V"
        config AXP202_DCDC3_VOLTAGE_BIT60_1V2
            bool "1.2V"
        config AXP202_DCDC3_VOLTAGE_BIT60_1V3
            bool "1.3V"
        config AXP202_DCDC3_VOLTAGE_BIT60_1V4
            bool "1.4V"
        config AXP202_DCDC3_VOLTAGE_BIT60_1V5
            bool "1.5V"
        config AXP202_DCDC3_VOLTAGE_BIT60_1V6
            bool "1.6V"
        config AXP202_DCDC3_VOLTAGE_BIT60_1V7
            bool "1.7V"
        config AXP202_DCDC3_VOLTAGE_BIT60_1V8
            bool "1.8V"
        config AXP202_DCDC3_VOLTAGE_BIT60_1V9
            bool "1.9V"
        config AXP202_DCDC3_VOLTAGE_BIT60_2V0
            bool "2.0V"
        config AXP202_DCDC3_VOLTAGE_BIT60_2V1
            bool "2.1V"
        config AXP202_DCDC3_VOLTAGE_BIT60_2V2
            bool "2.2V"
        config AXP202_DCDC3_VOLTAGE_BIT60_2V3
            bool "2.3V"
        config AXP202_DCDC3_VOLTAGE_BIT60_2V3
            bool "2.4V"
        config AXP202_DCDC3_VOLTAGE_BIT60_2V4
            bool "2.5V"
        config AXP202_DCDC3_VOLTAGE_BIT60_2V5
            bool "2.6V"
        config AXP202_DCDC3_VOLTAGE_BIT60_2V6
            bool "2.6V"
        config AXP202_DCDC3_VOLTAGE_BIT60_2V7
            bool "2.7V"
        config AXP202_DCDC3_VOLTAGE_BIT60_2V8
            bool "2.8V"
        config AXP202_DCDC3_VOLTAGE_BIT60_2V9
            bool "2.9V"
        config AXP202_DCDC3_VOLTAGE_BIT60_3V0
            bool "3.0V"
        config AXP202_DCDC3_VOLTAGE_BIT60_3V1
            bool "3.1V"
        config AXP202_DCDC3_VOLTAGE_BIT60_3V2
            bool "3.2V"
        config AXP202_DCDC3_VOLTAGE_BIT60_3V3
            bool "3.3V"
        config AXP202_DCDC3_VOLTAGE_BIT60_3V4
            bool "3.4V"
        config AXP202_DCDC3_VOLTAGE_BIT60_3V5
            bool "3.5V"
    endchoice

    config AXP202_DCDC3_VOLTAGE_BIT60
        hex
        default 0x00 if AXP202_DCDC3_VOLTAGE_BIT60_0V7
        default 0x04 if AXP202_DCDC3_VOLTAGE_BIT60_0V8
        default 0x08 if AXP202_DCDC3_VOLTAGE_BIT60_0V9
        default 0x0c if AXP202_DCDC3_VOLTAGE_BIT60_1V0
        default 0x10 if AXP202_DCDC3_VOLTAGE_BIT60_1V1
        default 0x14 if AXP202_DCDC3_VOLTAGE_BIT60_1V2
        default 0x18 if AXP202_DCDC3_VOLTAGE_BIT60_1V3
        default 0x1c if AXP202_DCDC3_VOLTAGE_BIT60_1V4
        default 0x20 if AXP202_DCDC3_VOLTAGE_BIT60_1V5
        default 0x24 if AXP202_DCDC3_VOLTAGE_BIT60_1V6
        default 0x28 if AXP202_DCDC3_VOLTAGE_BIT60_1V7
        default 0x2c if AXP202_DCDC3_VOLTAGE_BIT60_1V8
        default 0x30 if AXP202_DCDC3_VOLTAGE_BIT60_1V9
        default 0x34 if AXP202_DCDC3_VOLTAGE_BIT60_2V0
        default 0x38 if AXP202_DCDC3_VOLTAGE_BIT60_2V1
        default 0x3c if AXP202_DCDC3_VOLTAGE_BIT60_2V2
        default 0x40 if AXP202_DCDC3_VOLTAGE_BIT60_2V3
        default 0x44 if AXP202_DCDC3_VOLTAGE_BIT60_2V4
        default 0x48 if AXP202_DCDC3_VOLTAGE_BIT60_2V5
        default 0x4c if AXP202_DCDC3_VOLTAGE_BIT60_2V6
        default 0x50 if AXP202_DCDC3_VOLTAGE_BIT60_2V7
        default 0x54 if AXP202_DCDC3_VOLTAGE_BIT60_2V8
        default 0x58 if AXP202_DCDC3_VOLTAGE_BIT60_2V9
        default 0x5c if AXP202_DCDC3_VOLTAGE_BIT60_3V0
        default 0x60 if AXP202_DCDC3_VOLTAGE_BIT60_3V1
        default 0x64 if AXP202_DCDC3_VOLTAGE_BIT60_3V2
        default 0x68 if AXP202_DCDC3_VOLTAGE_BIT60_3V3
        default 0x6c if AXP202_DCDC3_VOLTAGE_BIT60_3V4
        default 0x70 if AXP202_DCDC3_VOLTAGE_BIT60_3V5

    choice AXP202_LDO24_VOLTAGE_BIT74
        prompt "LDO2 output voltage"
        default AXP202_LDO24_VOLTAGE_BIT74_3V0
        config AXP202_LDO24_VOLTAGE_BIT74_1V8
            bool "1.8V"
        config AXP202_LDO24_VOLTAGE_BIT74_1V9
            bool "1.9V"
        config AXP202_LDO24_VOLTAGE_BIT74_2V0
            bool "2.0V"
        config AXP202_LDO24_VOLTAGE_BIT74_2V1
            bool "2.1V"
        config AXP202_LDO24_VOLTAGE_BIT74_2V2
            bool "2.2V"
        config AXP202_LDO24_VOLTAGE_BIT74_2V3
            bool "2.3V"
        config AXP202_LDO24_VOLTAGE_BIT74_2V3
            bool "2.4V"
        config AXP202_LDO24_VOLTAGE_BIT74_2V4
            bool "2.5V"
        config AXP202_LDO24_VOLTAGE_BIT74_2V5
            bool "2.6V"
        config AXP202_LDO24_VOLTAGE_BIT74_2V6
            bool "2.6V"
        config AXP202_LDO24_VOLTAGE_BIT74_2V7
            bool "2.7V"
        config AXP202_LDO24_VOLTAGE_BIT74_2V8
            bool "2.8V"
        config AXP202_LDO24_VOLTAGE_BIT74_2V9
            bool "2.9V"
        config AXP202_LDO24_VOLTAGE_BIT74_3V0
            bool "3.0V"
        config AXP202_LDO24_VOLTAGE_BIT74_3V1
            bool "3.1V"
        config AXP202_LDO24_VOLTAGE_BIT74_3V2
            bool "3.2V"
        config AXP202_LDO24_VOLTAGE_BIT74_3V3
            bool "3.3V"
    endchoice

    config AXP202_LDO24_VOLTAGE_BIT74
        hex
        default 0x00 if AXP202_LDO24_VOLTAGE_BIT74_1V8
        default 0x10 if AXP202_LDO24_VOLTAGE_BIT74_1V9
        default 0x20 if AXP202_LDO24_VOLTAGE_BIT74_2V0
        default 0x30 if AXP202_LDO24_VOLTAGE_BIT74_2V1
        default 0x40 if AXP202_LDO24_VOLTAGE_BIT74_2V2
        default 0x50 if AXP202_LDO24_VOLTAGE_BIT74_2V3
        default 0x60 if AXP202_LDO24_VOLTAGE_BIT74_2V4
        default 0x70 if AXP202_LDO24_VOLTAGE_BIT74_2V5
        default 0x80 if AXP202_LDO24_VOLTAGE_BIT74_2V6
        default 0x90 if AXP202_LDO24_VOLTAGE_BIT74_2V7
        default 0xa0 if AXP202_LDO24_VOLTAGE_BIT74_2V8
        default 0xb0 if AXP202_LDO24_VOLTAGE_BIT74_2V9
        default 0xc0 if AXP202_LDO24_VOLTAGE_BIT74_3V0
        default 0xd0 if AXP202_LDO24_VOLTAGE_BIT74_3V1
        default 0xe0 if AXP202_LDO24_VOLTAGE_BIT74_3V2
        default 0xf0 if AXP202_LDO24_VOLTAGE_BIT74_3V3

    choice AXP202_LDO24_VOLTAGE_BIT30
        prompt "LDO4 output voltage"
        default AXP202_LDO24_VOLTAGE_BIT30_3V0
        config AXP202_LDO24_VOLTAGE_BIT30_1V25
            bool "1.25V"
        config AXP202_LDO24_VOLTAGE_BIT30_1V3
            bool "1.3V"
        config AXP202_LDO24_VOLTAGE_BIT30_1V4
            bool "1.4V"
        config AXP202_LDO24_VOLTAGE_BIT30_1V5
            bool "1.5V"
        config AXP202_LDO24_VOLTAGE_BIT30_1V6
            bool "1.6V"
        config AXP202_LDO24_VOLTAGE_BIT30_1V7
            bool "1.7V"
        config AXP202_LDO24_VOLTAGE_BIT30_1V8
            bool "1.8V"
        config AXP202_LDO24_VOLTAGE_BIT30_1V9
            bool "1.9V"
        config AXP202_LDO24_VOLTAGE_BIT30_2V0
            bool "2.0V"
        config AXP202_LDO24_VOLTAGE_BIT30_2V5
            bool "2.5V"
        config AXP202_LDO24_VOLTAGE_BIT30_2V7
            bool "2.7V"
        config AXP202_LDO24_VOLTAGE_BIT30_2V8
            bool "2.8V"
        config AXP202_LDO24_VOLTAGE_BIT30_3V0
            bool "3.0V"
        config AXP202_LDO24_VOLTAGE_BIT30_3V1
            bool "3.1V"
        config AXP202_LDO24_VOLTAGE_BIT30_3V2
            bool "3.2V"
        config AXP202_LDO24_VOLTAGE_BIT30_3V3
            bool "3.3V"
    endchoice

    config AXP202_LDO24_VOLTAGE_BIT30
        hex
        default 0x01 if AXP202_LDO24_VOLTAGE_BIT30_1V25
        default 0x02 if AXP202_LDO24_VOLTAGE_BIT30_1V3
        default 0x03 if AXP202_LDO24_VOLTAGE_BIT30_1V4
        default 0x04 if AXP202_LDO24_VOLTAGE_BIT30_1V5
        default 0x05 if AXP202_LDO24_VOLTAGE_BIT30_1V6
        default 0x06 if AXP202_LDO24_VOLTAGE_BIT30_1V7
        default 0x07 if AXP202_LDO24_VOLTAGE_BIT30_1V8
        default 0x08 if AXP202_LDO24_VOLTAGE_BIT30_1V9
        default 0x09 if AXP202_LDO24_VOLTAGE_BIT30_2V0
        default 0x0a if AXP202_LDO24_VOLTAGE_BIT30_2V5
        default 0x0b if AXP202_LDO24_VOLTAGE_BIT30_2V6
        default 0x0c if AXP202_LDO24_VOLTAGE_BIT30_2V8
        default 0x0d if AXP202_LDO24_VOLTAGE_BIT30_3V0
        default 0x0e if AXP202_LDO24_VOLTAGE_BIT30_3V1
        default 0x0f if AXP202_LDO24_VOLTAGE_BIT30_3V2
        default 0x10 if AXP202_LDO24_VOLTAGE_BIT30_3V3

    choice AXP202_LDO3_VOLTAGE_BIT60
        prompt "LDO3 output voltage"
        default AXP202_LDO3_VOLTAGE_BIT60_3V0
        config AXP202_LDO3_VOLTAGE_BIT60_0V7
            bool "0.7V"
        config AXP202_LDO3_VOLTAGE_BIT60_0V8
            bool "0.8V"
        config AXP202_LDO3_VOLTAGE_BIT60_0V9
            bool "0.9V"
        config AXP202_LDO3_VOLTAGE_BIT60_1V0
            bool "1.0V"
        config AXP202_LDO3_VOLTAGE_BIT60_1V1
            bool "1.1V"
        config AXP202_LDO3_VOLTAGE_BIT60_1V2
            bool "1.2V"
        config AXP202_LDO3_VOLTAGE_BIT60_1V3
            bool "1.3V"
        config AXP202_LDO3_VOLTAGE_BIT60_1V4
            bool "1.4V"
        config AXP202_LDO3_VOLTAGE_BIT60_1V5
            bool "1.5V"
        config AXP202_LDO3_VOLTAGE_BIT60_1V6
            bool "1.6V"
        config AXP202_LDO3_VOLTAGE_BIT60_1V7
            bool "1.7V"
        config AXP202_LDO3_VOLTAGE_BIT60_1V8
            bool "1.8V"
        config AXP202_LDO3_VOLTAGE_BIT60_1V9
            bool "1.9V"
        config AXP202_LDO3_VOLTAGE_BIT60_2V0
            bool "2.0V"
        config AXP202_LDO3_VOLTAGE_BIT60_2V1
            bool "2.1V"
        config AXP202_LDO3_VOLTAGE_BIT60_2V2
            bool "2.2V"
        config AXP202_LDO3_VOLTAGE_BIT60_2V3
            bool "2.3V"
        config AXP202_LDO3_VOLTAGE_BIT60_2V3
            bool "2.4V"
        config AXP202_LDO3_VOLTAGE_BIT60_2V4
            bool "2.5V"
        config AXP202_LDO3_VOLTAGE_BIT60_2V5
            bool "2.6V"
        config AXP202_LDO3_VOLTAGE_BIT60_2V6
            bool "2.6V"
        config AXP202_LDO3_VOLTAGE_BIT60_2V7
            bool "2.7V"
        config AXP202_LDO3_VOLTAGE_BIT60_2V8
            bool "2.8V"
        config AXP202_LDO3_VOLTAGE_BIT60_2V9
            bool "2.9V"
        config AXP202_LDO3_VOLTAGE_BIT60_3V0
            bool "3.0V"
        config AXP202_LDO3_VOLTAGE_BIT60_3V1
            bool "3.1V"
        config AXP202_LDO3_VOLTAGE_BIT60_3V2
            bool "3.2V"
        config AXP202_LDO3_VOLTAGE_BIT60_3V3
            bool "3.3V"
        config AXP202_LDO3_VOLTAGE_BIT60_3V4
            bool "3.4V"
        config AXP202_LDO3_VOLTAGE_BIT60_3V5
            bool "3.5V"
    endchoice

    config AXP202_LDO3_VOLTAGE_BIT60
        hex
        default 0x00 if AXP202_LDO3_VOLTAGE_BIT60_0V7
        default 0x04 if AXP202_LDO3_VOLTAGE_BIT60_0V8
        default 0x08 if AXP202_LDO3_VOLTAGE_BIT60_0V9
        default 0x0c if AXP202_LDO3_VOLTAGE_BIT60_1V0
        default 0x10 if AXP202_LDO3_VOLTAGE_BIT60_1V1
        default 0x14 if AXP202_LDO3_VOLTAGE_BIT60_1V2
        default 0x18 if AXP202_LDO3_VOLTAGE_BIT60_1V3
        default 0x1c if AXP202_LDO3_VOLTAGE_BIT60_1V4
        default 0x20 if AXP202_LDO3_VOLTAGE_BIT60_1V5
        default 0x24 if AXP202_LDO3_VOLTAGE_BIT60_1V6
        default 0x28 if AXP202_LDO3_VOLTAGE_BIT60_1V7
        default 0x2c if AXP202_LDO3_VOLTAGE_BIT60_1V8
        default 0x30 if AXP202_LDO3_VOLTAGE_BIT60_1V9
        default 0x34 if AXP202_LDO3_VOLTAGE_BIT60_2V0
        default 0x38 if AXP202_LDO3_VOLTAGE_BIT60_2V1
        default 0x3c if AXP202_LDO3_VOLTAGE_BIT60_2V2
        default 0x40 if AXP202_LDO3_VOLTAGE_BIT60_2V3
        default 0x44 if AXP202_LDO3_VOLTAGE_BIT60_2V4
        default 0x48 if AXP202_LDO3_VOLTAGE_BIT60_2V5
        default 0x4c if AXP202_LDO3_VOLTAGE_BIT60_2V6
        default 0x50 if AXP202_LDO3_VOLTAGE_BIT60_2V7
        default 0x54 if AXP202_LDO3_VOLTAGE_BIT60_2V8
        default 0x58 if AXP202_LDO3_VOLTAGE_BIT60_2V9
        default 0x5c if AXP202_LDO3_VOLTAGE_BIT60_3V0
        default 0x60 if AXP202_LDO3_VOLTAGE_BIT60_3V1
        default 0x64 if AXP202_LDO3_VOLTAGE_BIT60_3V2
        default 0x68 if AXP202_LDO3_VOLTAGE_BIT60_3V3
        default 0x6c if AXP202_LDO3_VOLTAGE_BIT60_3V4
        default 0x70 if AXP202_LDO3_VOLTAGE_BIT60_3V5

endmenu

menu "ADC control"
    config AXP202_ADC_ENABLE_1_BIT7_SELECTED
        bool "Enable BAT boltage ADC"
    config AXP202_ADC_ENABLE_1_BIT6_SELECTED
        bool "Enable BAT current ADC"
    config AXP202_ADC_ENABLE_1_BIT5_SELECTED
        bool "Enable ACIN voltage ADC"
    config AXP202_ADC_ENABLE_1_BIT4_SELECTED
        bool "Enable ACIN current ADC"
    config AXP202_ADC_ENABLE_1_BIT3_SELECTED
        bool "Enable VBUS voltage ADC"
    config AXP202_ADC_ENABLE_1_BIT2_SELECTED
        bool "Enable VBUS current ADC"
    config AXP202_ADC_ENABLE_1_BIT1_SELECTED
        bool "Enable APS voltage ADC"
    config AXP202_ADC_ENABLE_1_BIT0_SELECTED
        bool "Enable TS ADC"

    config AXP202_ADC_ENABLE_2_BIT7_SELECTED
        bool "Enable internal temperature ADC"
    config AXP202_ADC_ENABLE_2_BIT3_SELECTED
        bool "Enable GPIO0 ADC"
    config AXP202_ADC_ENABLE_2_BIT2_SELECTED
        bool "Enable GPIO1 ADC"
endmenu

config AXP202_ADC_ENABLE_1_BIT7
    hex
    default 0x00 if !AXP202_ADC_ENABLE_1_BIT7_SELECTED
    default 0x80 if AXP202_ADC_ENABLE_1_BIT7_SELECTED

config AXP202_ADC_ENABLE_1_BIT6
    hex
    default 0x00 if !AXP202_ADC_ENABLE_1_BIT6_SELECTED
    default 0x40 if AXP202_ADC_ENABLE_1_BIT6_SELECTED

config AXP202_ADC_ENABLE_1_BIT5
    hex
    default 0x00 if !AXP202_ADC_ENABLE_1_BIT5_SELECTED
    default 0x20 if AXP202_ADC_ENABLE_1_BIT5_SELECTED

config AXP202_ADC_ENABLE_1_BIT4
    hex
    default 0x00 if !AXP202_ADC_ENABLE_1_BIT4_SELECTED
    default 0x10 if AXP202_ADC_ENABLE_1_BIT4_SELECTED

config AXP202_ADC_ENABLE_1_BIT3
    hex
    default 0x00 if !AXP202_ADC_ENABLE_1_BIT3_SELECTED
    default 0x08 if AXP202_ADC_ENABLE_1_BIT3_SELECTED

config AXP202_ADC_ENABLE_1_BIT2
    hex
    default 0x00 if !AXP202_ADC_ENABLE_1_BIT2_SELECTED
    default 0x04 if AXP202_ADC_ENABLE_1_BIT2_SELECTED

config AXP202_ADC_ENABLE_1_BIT1
    hex
    default 0x00 if !AXP202_ADC_ENABLE_1_BIT1_SELECTED
    default 0x02 if AXP202_ADC_ENABLE_1_BIT1_SELECTED

config AXP202_ADC_ENABLE_1_BIT0
    hex
    default 0x00 if !AXP202_ADC_ENABLE_1_BIT0_SELECTED
    default 0x01 if AXP202_ADC_ENABLE_1_BIT0_SELECTED

config AXP202_ADC_ENABLE_2_BIT7
    hex
    default 0x00 if !AXP202_ADC_ENABLE_1_BIT7_SELECTED
    default 0x80 if AXP202_ADC_ENABLE_1_BIT7_SELECTED

config AXP202_ADC_ENABLE_2_BIT3
    hex
    default 0x00 if !AXP202_ADC_ENABLE_1_BIT3_SELECTED
    default 0x08 if AXP202_ADC_ENABLE_1_BIT3_SELECTED

config AXP202_ADC_ENABLE_2_BIT2
    hex
    default 0x00 if !AXP202_ADC_ENABLE_1_BIT2_SELECTED
    default 0x04 if AXP202_ADC_ENABLE_1_BIT2_SELECTED


menu "Charge control"
    config AXP202_CHARGE_CONTROL_1_BIT7_SELECTED
        bool "Enable charging"

        config AXP202_CHARGE_CONTROL_1_BIT7
            hex
            default 0x00 if !AXP202_CHARGE_CONTROL_1_BIT7_SELECTED
            default 0x80 if AXP202_CHARGE_CONTROL_1_BIT7_SELECTED

        if AXP202_CHARGE_CONTROL_1_BIT7_SELECTED

            choice AXP202_CHARGE_CONTROL_1_BIT65
                prompt "Charge target voltage"
                default AXP202_CHARGE_CONTROL_1_BIT65_42_SELECTED
                config AXP202_CHARGE_CONTROL_1_BIT65_41_SELECTED
                    bool "4.1V"
                config AXP202_CHARGE_CONTROL_1_BIT65_415_SELECTED
                    bool "4.15V"
                config AXP202_CHARGE_CONTROL_1_BIT65_42_SELECTED
                    bool "4.2V"
                config AXP202_CHARGE_CONTROL_1_BIT65_436_SELECTED
                    bool "4.36V"
            endchoice

            config AXP202_CHARGE_CONTROL_1_BIT65
                hex
                default 0x00 if AXP202_CHARGE_CONTROL_1_BIT65_41_SELECTED
                default 0x20 if AXP202_CHARGE_CONTROL_1_BIT65_415_SELECTED
                default 0x40 if AXP202_CHARGE_CONTROL_1_BIT65_42_SELECTED
                default 0x60 if AXP202_CHARGE_CONTROL_1_BIT65_436_SELECTED

            choice AXP202_CHARGE_CONTROL_1_BIT30
                prompt "Charge current"
                default AXP202_CHARGE_CONTROL_1_BIT30_300_SELECTED
                config AXP202_CHARGE_CONTROL_1_BIT30_300_SELECTED
                    bool "300mA"
                config AXP202_CHARGE_CONTROL_1_BIT30_400_SELECTED
                    bool "400mA"
                config AXP202_CHARGE_CONTROL_1_BIT30_500_SELECTED
                    bool "500mA"
                config AXP202_CHARGE_CONTROL_1_BIT30_600_SELECTED
                    bool "600mA"
                config AXP202_CHARGE_CONTROL_1_BIT30_700_SELECTED
                    bool "700mA"
                config AXP202_CHARGE_CONTROL_1_BIT30_800_SELECTED
                    bool "800mA"
                config AXP202_CHARGE_CONTROL_1_BIT30_900_SELECTED
                    bool "900mA"
                config AXP202_CHARGE_CONTROL_1_BIT30_1000_SELECTED
                    bool "1000mA"
                config AXP202_CHARGE_CONTROL_1_BIT30_1100_SELECTED
                    bool "1100mA"
                config AXP202_CHARGE_CONTROL_1_BIT30_1200_SELECTED
                    bool "1200mA"
                config AXP202_CHARGE_CONTROL_1_BIT30_1300_SELECTED
                    bool "1300mA"
                config AXP202_CHARGE_CONTROL_1_BIT30_1400_SELECTED
                    bool "1400mA"
                config AXP202_CHARGE_CONTROL_1_BIT30_1500_SELECTED
                    bool "1500mA"
                config AXP202_CHARGE_CONTROL_1_BIT30_1600_SELECTED
                    bool "1600mA"
                config AXP202_CHARGE_CONTROL_1_BIT30_1700_SELECTED
                    bool "1700mA"
            endchoice

            config AXP202_CHARGE_CONTROL_1_BIT30
                hex
                default 0x00 if AXP202_CHARGE_CONTROL_1_BIT30_300_SELECTED
                default 0x01 if AXP202_CHARGE_CONTROL_1_BIT30_400_SELECTED
                default 0x02 if AXP202_CHARGE_CONTROL_1_BIT30_500_SELECTED
                default 0x03 if AXP202_CHARGE_CONTROL_1_BIT30_600_SELECTED
                default 0x04 if AXP202_CHARGE_CONTROL_1_BIT30_700_SELECTED
                default 0x05 if AXP202_CHARGE_CONTROL_1_BIT30_800_SELECTED
                default 0x06 if AXP202_CHARGE_CONTROL_1_BIT30_900_SELECTED
                default 0x07 if AXP202_CHARGE_CONTROL_1_BIT30_1000_SELECTED
                default 0x08 if AXP202_CHARGE_CONTROL_1_BIT30_1100_SELECTED
                default 0x0a if AXP202_CHARGE_CONTROL_1_BIT30_1200_SELECTED
                default 0x0b if AXP202_CHARGE_CONTROL_1_BIT30_1300_SELECTED
                default 0x0c if AXP202_CHARGE_CONTROL_1_BIT30_1400_SELECTED
                default 0x0d if AXP202_CHARGE_CONTROL_1_BIT30_1500_SELECTED
                default 0x0e if AXP202_CHARGE_CONTROL_1_BIT30_1600_SELECTED
                default 0x0f if AXP202_CHARGE_CONTROL_1_BIT30_1700_SELECTED

            choice AXP202_CHARGE_CONTROL_1_BIT4
                prompt "Charge end current"
                help
                    When charging the battery chargin current will gradually will
                    gradually drop towards the end. This setting will determine when
                    to stop the charging process.

                    For example if set to 10% and charge current was set to 1000mA
                    charging will end when the charging current has dropped to 100mA.
                default AXP202_CHARGE_CONTROL_1_BIT4_15_SELECTED

                config AXP202_CHARGE_CONTROL_1_BIT4_10_SELECTED
                    bool "10%"
                config AXP202_CHARGE_CONTROL_1_BIT4_15_SELECTED
                    bool "15%"
            endchoice

            config AXP202_CHARGE_CONTROL_1_BIT4
                hex
                default 0x00 if AXP202_CHARGE_CONTROL_1_BIT4_10_SELECTED
                default 0x10 if AXP202_CHARGE_CONTROL_1_BIT4_15_SELECTED

        endif
endmenu


endmenu
```
