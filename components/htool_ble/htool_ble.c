/*
Copyright (c) 2023 kl0ibi

Permission is hereby granted, free of charge, to any person obtaining a copy
of this software and associated documentation files (the "Software"), to deal
in the Software without restriction, including without limitation the rights
to use, copy, modify, merge, publish, distribute, sublicense, and/or sell
copies of the Software, and to permit persons to whom the Software is
furnished to do so, subject to the following conditions:

The above copyright notice and this permission notice shall be included in all
copies or substantial portions of the Software.

THE SOFTWARE IS PROVIDED "AS IS", WITHOUT WARRANTY OF ANY KIND, EXPRESS OR
IMPLIED, INCLUDING BUT NOT LIMITED TO THE WARRANTIES OF MERCHANTABILITY,
FITNESS FOR A PARTICULAR PURPOSE AND NONINFRINGEMENT. IN NO EVENT SHALL THE
AUTHORS OR COPYRIGHT HOLDERS BE LIABLE FOR ANY CLAIM, DAMAGES OR OTHER
LIABILITY, WHETHER IN AN ACTION OF CONTRACT, TORT OR OTHERWISE, ARISING FROM,
OUT OF OR IN CONNECTION WITH THE SOFTWARE OR THE USE OR OTHER DEALINGS IN THE
SOFTWARE.
 */
#include "htool_ble.h"
#include "esp_system.h"
#include "freertos/FreeRTOS.h"
#include "freertos/task.h"
#include "esp_log.h"
#include "esp_bt.h"
#include "nvs.h"
#include "nvs_flash.h"
#include "esp_gap_ble_api.h"
#include "esp_gatts_api.h"
#include "esp_bt_main.h"
#include "esp_gatt_common_api.h"

#define TAG "htool_ble"

const esp_ble_adv_params_t adv_params = {
    .adv_int_min       = 0x20,
    .adv_int_max       = 0x40,
    .adv_type          = ADV_TYPE_SCAN_IND,
    .own_addr_type     = BLE_ADDR_TYPE_PUBLIC,
    .channel_map       = ADV_CHNL_ALL,
    .adv_filter_policy = ADV_FILTER_ALLOW_SCAN_ANY_CON_ANY,
};

static bool ble_init = false;
static bool ble_adv_running = false;


const uint8_t apple_adv[29][31] = {
    {0x1e, 0xff, 0x4c, 0x00, 0x07, 0x19, 0x07, 0x02, 0x20, 0x75, 0xaa, 0x30, 0x01, 0x00, 0x00, 0x45, 0x12, 0x12, 0x12, 0x00, 0x00, 0x00, 0x00, 0x00, 0x00, 0x00, 0x00, 0x00, 0x00, 0x00, 0x00},
    {0x1e, 0xff, 0x4c, 0x00, 0x07, 0x19, 0x07, 0x0e, 0x20, 0x75, 0xaa, 0x30, 0x01, 0x00, 0x00, 0x45, 0x12, 0x12, 0x12, 0x00, 0x00, 0x00, 0x00, 0x00, 0x00, 0x00, 0x00, 0x00, 0x00, 0x00, 0x00},
    {0x1e, 0xff, 0x4c, 0x00, 0x07, 0x19, 0x07, 0x0a, 0x20, 0x75, 0xaa, 0x30, 0x01, 0x00, 0x00, 0x45, 0x12, 0x12, 0x12, 0x00, 0x00, 0x00, 0x00, 0x00, 0x00, 0x00, 0x00, 0x00, 0x00, 0x00, 0x00},
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    {0x16, 0xff, 0x4c, 0x00, 0x04, 0x04, 0x2a, 0x00, 0x00, 0x00, 0x0f, 0x05, 0xc1, 0x1e, 0x60, 0x4c, 0x95, 0x00, 0x00, 0x10, 0x00, 0x00, 0x00},
};

uint8_t google_adv[14] = {0x03, 0x03, 0x2C, 0xFE, 0x06, 0x16, 0x2C, 0xFE, 0x00, 0xB7, 0x27, 0x02, 0x0A, 0x00};
uint8_t samsung_adv[15] = {0x0E, 0xFF, 0x75, 0x00, 0x01, 0x00, 0x02, 0x01, 0x01, 0xFF, 0x00, 0x00, 0x43, 0x00};
uint8_t microsoft_adv[15] = {0x0E, 0xFF, 0x06, 0x00, 0x03, 0x00, 0x80, 0x00, 0x00, 0x00, 0x00, 0x00, 0x00, 0x00};


bool htool_ble_adv_running() {
    return ble_adv_running;
}

static char generate_random_char() {
    uint8_t random_num = esp_random() % 62;

    if (random_num < 10) {
        return (char)('0' + random_num);
    }
    else if (random_num < 36) {
        return (char)('A' + (random_num - 10));
    }
    else {
        return (char)('a' + (random_num - 36));
    }
}


void htool_ble_set_adv_data(adv_t index) {
    if (index == ADV_RANDOM) {
        index = esp_random() % ADV_RANDOM;
    }
    if (index == ADV_APPLE_RANDOM) {
        index = esp_random() % ADV_APPLE_TVCOLORBALANCE;
    }
    else if (index == ADV_GOOGLE) {
        google_adv[13] = (esp_random() % 120) - 100;
    }
    else if (index == ADV_SAMSUNG_RANDOM) {
        samsung_adv[14] = (esp_random() % 32) + 1;
    }
    else if (index == ADV_SAMSUNG_WATCH4) {
        samsung_adv[14] = 0x04;
    }
    else if (index == ADV_SAMSUNG_FRENCH_WATCH4) {
        samsung_adv[14] = 0x0A;
    }
    else if (index == ADV_SAMSUNG_FOX_WATCH5) {
        samsung_adv[14] = 0x0C;
    }
    else if (index == ADV_SAMSUNG_WATCH5) {
        samsung_adv[14] = 0x11;
    }
    else if (index == ADV_SAMSUNG_WATCH5_PRO) {
        samsung_adv[14] = 0x15;
    }
    else if (index == ADV_SAMSUNG_WATCH6) {
        samsung_adv[14] = 0x1E;
    }
    else if (index == ADV_MICROSOFT) {
        microsoft_adv[7] = generate_random_char();
        microsoft_adv[8] = generate_random_char();
        microsoft_adv[9] = generate_random_char();
        microsoft_adv[10] = generate_random_char();
        microsoft_adv[11] = generate_random_char();
        microsoft_adv[12] = generate_random_char();
        microsoft_adv[13] = generate_random_char();
        microsoft_adv[14] = generate_random_char();
    }
    else {
        index--;
    }
    if (index == ADV_GOOGLE) {
        esp_ble_gap_config_adv_data_raw((uint8_t *)google_adv, 14);
    }
    else if (index >= ADV_SAMSUNG_RANDOM && index <= ADV_SAMSUNG_WATCH6) {
        esp_ble_gap_config_adv_data_raw((uint8_t *)samsung_adv, 15);
    }
    else if (index == ADV_MICROSOFT) {
        esp_ble_gap_config_adv_data_raw((uint8_t *)microsoft_adv, 15);
    }
    else {
        esp_ble_gap_config_adv_data_raw((uint8_t *)apple_adv[index], index > 16 ? 23 : 31);
    }
}


void htool_ble_start_adv() {
    esp_ble_gap_start_advertising((esp_ble_adv_params_t *)&adv_params);
    ble_adv_running = true;
}


void htool_ble_stop_adv() {
    esp_ble_gap_stop_advertising();
    ble_adv_running = false;
}


uint8_t htool_ble_deinit() {
    if (ble_init) {
        if (esp_bluedroid_disable() != ESP_OK) {
            ESP_LOGE(TAG, "Failed to disable bluedroid");
            return HTOOL_BLE_ERR;
        }
        if (esp_bluedroid_deinit() != ESP_OK) {
            ESP_LOGE(TAG, "Failed to deinitialize bluedroid");
            return HTOOL_BLE_ERR;
        }
        if (esp_bt_controller_disable() != ESP_OK) {
            ESP_LOGE(TAG, "Failed to disable BLE controller");
            return HTOOL_BLE_ERR;
        }
        if (esp_bt_controller_deinit() != ESP_OK) {
            ESP_LOGE(TAG, "Failed to deinitialize BLE controller");
            return HTOOL_BLE_ERR;
        }
        ble_init = false;
    }

    return HTOOL_BLE_OK;
}


uint8_t htool_ble_init() {
    if (!ble_init) {
        esp_bt_controller_config_t bt_cfg = BT_CONTROLLER_INIT_CONFIG_DEFAULT();
        if (esp_bt_controller_init(&bt_cfg) != ESP_OK) {
            ESP_LOGE(TAG, "initialize bt controller failed");
            return HTOOL_BLE_ERR;
        }
        if (esp_bt_controller_enable(ESP_BT_MODE_BLE) != ESP_OK) {
            ESP_LOGE(TAG, "enable ble controller failed");
            return HTOOL_BLE_ERR;
        }
        if (esp_bluedroid_init() != ESP_OK) {
            ESP_LOGE(TAG, "init bluedroid failed");
            return HTOOL_BLE_ERR;
        }
        if (esp_bluedroid_enable() != ESP_OK) {
            ESP_LOGE(TAG, "bluedroid enable failed");
            return HTOOL_BLE_ERR;
        }
        if (esp_ble_tx_power_set(ESP_BLE_PWR_TYPE_ADV, ESP_PWR_LVL_P9) != ESP_OK) {
            ESP_LOGE(TAG, "error setting ble tx power");
            return HTOOL_BLE_ERR;
        }
        ble_init = true;
    }

    return HTOOL_BLE_OK;
}
